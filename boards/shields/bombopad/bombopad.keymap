#include <behaviors.dtsi>
#include <dt-bindings/zmk/keys.h>
#include <dt-bindings/zmk/bt.h>
#include <dt-bindings/zmk/outputs.h>

/*
 * keycode equivalence between GNU/Linux and macOS
 * |-----------------------------------|
 * |  Linux |  macOS | fun()  |
 * |--------|--------|--------|
 * |  LALT  |  LALT  |   LA   |
 * |--------|--------|--------|
 * |  RALT  |  RALT  |   RA   |
 * |--------|--------|--------|
 * |  LGUI  |  LCMD  |   LG   |
 * |--------|--------|--------|
 * |  RGUI  |  RCMD  |   RG   |
 * |--------------------------|
 */

#define NUM 0
#define MGMT 1

/ {
    keymap {
        compatible = "zmk,keymap";

        base_layer {
            display-name = " NUM";

            bindings = <
    &kp N7                  &kp N8                  &kp N9                  &kp 0
    &kp N4                  &kp N5                  &kp N6                  &kp ENTER
    &kp N1                  &kp N2                  &kp N3                  &cycle_layer MGMT MGMT
            >;

            sensor-bindings = <&inc_dec_kp K_VOL_UP K_VOL_DN &inc_dec_kp LG(K_VOL_UP) LG(K_VOL_DN)>;
        };

        management_layer {
            display-name = "MGMT";

            bindings = <
    &sys_reset              &bootloader             &none                   &trans
    &out OUT_USB            &out OUT_BLE            &out OUT_TOG            &trans
#if IS_ENABLED(CONFIG_ZMK_DISPLAY)
    &bt BT_PRV              &bt BT_NXT              &bt BT_CLR              &cycle_layer MGMT NUM
#else
    &bt BT_SEL 0            &bt BT_SEL 1            &bt BT_CLR              &cycle_layer MGMT NUM
#endif
            >;

            sensor-bindings = <&inc_dec_kp K_VOL_UP K_VOL_DN &inc_dec_kp LG(K_VOL_UP) LG(K_VOL_DN)>;
        };
    };
};
